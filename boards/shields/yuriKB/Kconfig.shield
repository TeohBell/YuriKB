## boards/shields/yuriKB/Kconfig.shield
```kconfig
config SHIELD_YURI_KB_LEFT
    def_bool $(shields_list_contains,yuri_KB_left)

config SHIELD_YURI_RIGHT
    def_bool $(shields_list_contains,yuri_KB_right)
```

## boards/shields/yuri_KB/Kconfig.defconfig
```kconfig
if SHIELD_YURI_KB_RIGHT

config ZMK_KEYBOARD_NAME
    default "Yuri KB"

config ZMK_SPLIT_BLE_ROLE_CENTRAL
    default y

endif

if SHIELD_YURI_KB_LEFT || SHIELD_YURI_KB_RIGHT
	config ZMK_SPLIT
    default y

endif
```

## config/Kconfig.defconfig
```kconfig
if SHIELD_YURI_KB_L

config ZMK_KEYBOARD_NAME
    default "yuri_KB"

config ZMK_SPLIT_ROLE_CENTRAL
    default y

endif

if SHIELD_YURI_L || SHIELD_YURI_KB_R

config ZMK_SPLIT
    default y

endif
```
