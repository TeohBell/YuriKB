#include "yuri_KB.dtsi" // Notice that the main dtsi files are included in the overlay.

&kscan0 {
    col-gpios
        = <&gpio0 10(GPIO_ACTIVE_HIGH | GPIO_PULL_DOWN)> // col5 in the schematic
        , <&gpio0 9(GPIO_ACTIVE_HIGH | GPIO_PULL_DOWN)> // col4 in the schematic
        , <&xiao_d 0(GPIO_ACTIVE_HIGH | GPIO_PULL_DOWN)> // col3 in the schematic
        , <&xiao_d 1(GPIO_ACTIVE_HIGH | GPIO_PULL_DOWN)> // col2 in the schematic
        , <&xiao_d 2(GPIO_ACTIVE_HIGH | GPIO_PULL_DOWN)> // col1 in the schematic
        , <&xiao_d 3(GPIO_ACTIVE_HIGH | GPIO_PULL_DOWN)> // col0 in the schematic
        ;
};

&left_encoder {
    status = "okay";
};
